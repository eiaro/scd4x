## drivers/sensor/sensirion/scd4x/Kconfig
```kconfig
config SCD4X
    bool "Sensirion SCD4X CO2 sensor"
    default y
    depends on DT_HAS_SENSIRION_SCD4X_ENABLED
    select I2C
    select CRC
    help
      Enable driver for Sensirion SCD4X CO2 sensor.
      
```

## dts/bindings/sensor/sensirion,scd4x.yaml
```yaml
description: SCD4X CO2 sensor

compatible: "sensirion,scd4x"

include: [sensor-device.yaml, i2c-device.yaml]
```
